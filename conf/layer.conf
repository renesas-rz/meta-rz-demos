## conf/layer.conf
```bitbake
# We have a conf and classes directory, add to BBPATH
BBPATH .= ":${LAYERDIR}"

# We have recipes-* directories, add to BBFILES
BBFILES += "${LAYERDIR}/recipes-*/*/*.bb \
            ${LAYERDIR}/recipes-*/*/*.bbappend"

BBFILE_COLLECTIONS += "rz-demos"
BBFILE_PATTERN_rz-demos := "^${LAYERDIR}/"

LAYERDEPENDS_rz-codecs = "rz-common"
LAYERSERIES_COMPAT_rz-demos = "dunfell"
```
